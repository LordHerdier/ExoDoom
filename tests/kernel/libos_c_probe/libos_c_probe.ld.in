/*
 * libos_c_probe.ld.in — links libos_c_probe.c at its real ring-3 addresses
 * (SCRUM-173).
 *
 * Preprocessed with the C preprocessor before being handed to ld
 * (docker/scripts/build.sh, `-x assembler-with-cpp` + `-DEXO_KERNEL`, the
 * same treatment the .s probes under this directory get), so
 * LIBOS_LAUNCH_CODE_VADDR/_DATA_VADDR below are the real macros from
 * src/libos_launch.h, not hand-copied literals.
 *
 * Unlike src/linker.ld (the kernel's own script, one flat image at a fixed
 * 2M base), this produces two separate regions in one ELF: .text at
 * LIBOS_LAUNCH_CODE_VADDR, .data/.bss at LIBOS_LAUNCH_DATA_VADDR --
 * mirroring exactly what libos_build_image() does at runtime, so ordinary
 * compiler-generated addressing between the two is correct without any
 * hand-written PIC convention.
 */
#include "libos_launch.h"

OUTPUT_FORMAT(elf64-x86-64)
ENTRY(libos_c_probe_main)

SECTIONS
{
    . = LIBOS_LAUNCH_CODE_VADDR;
    .text : { *(.text) *(.text.*) *(.rodata*) }

    . = LIBOS_LAUNCH_DATA_VADDR;
    .data : { *(.data) }

    /* NOLOAD: nothing here is real file content, just the address range
     * libos_build_image() zero-fills for `bss_len`. The two symbols let
     * build.sh compute that length (via nm) without duplicating
     * LIBOS_LAUNCH_MAX_DATA_PAGES arithmetic or trusting an empty section
     * to still report a correct size through other means. */
    .bss (NOLOAD) : {
        __libos_c_probe_bss_start = .;
        *(COMMON)
        *(.bss)
        __libos_c_probe_bss_end = .;
    }

    /DISCARD/ : { *(.comment) *(.eh_frame*) *(.note.*) }
}
