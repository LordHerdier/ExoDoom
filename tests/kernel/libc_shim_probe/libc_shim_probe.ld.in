/*
 * libc_shim_probe.ld.in — links the compiled libc shim + probe main at
 * their real ring-3 addresses (SCRUM-51).
 *
 * Identical shape to tests/kernel/libos_c_probe/libos_c_probe.ld.in -- see
 * that file's comment for why .text goes at LIBOS_LAUNCH_CODE_VADDR and
 * .data/.bss at LIBOS_LAUNCH_DATA_VADDR. This link target additionally
 * pulls in src/stdlib.c, src/stdio.c, src/string.c, src/ctype.c,
 * src/libos_heap.c and src/libos_page_alloc.c (compiled without
 * -DEXO_KERNEL by this file's own build.sh step) alongside
 * libc_shim_probe.c itself -- more object files feeding the same two
 * sections, not a different layout.
 */
#include "libos_launch.h"

OUTPUT_FORMAT(elf64-x86-64)
ENTRY(libc_shim_probe_main)

SECTIONS
{
    . = LIBOS_LAUNCH_CODE_VADDR;
    .text : { *(.text) *(.text.*) *(.rodata*) }

    . = LIBOS_LAUNCH_DATA_VADDR;
    .data : { *(.data) }

    /* NOLOAD: nothing here is real file content, just the address range
     * libos_build_image() zero-fills for `bss_len`. The two symbols let
     * build.sh compute that length (via nm) the same way
     * libos_c_probe.ld.in's do. */
    .bss (NOLOAD) : {
        __libc_shim_probe_bss_start = .;
        *(COMMON)
        *(.bss)
        __libc_shim_probe_bss_end = .;
    }

    /DISCARD/ : { *(.comment) *(.eh_frame*) *(.note.*) }
}
